## config/boards/shields/nice_ergodox/Kconfig.defconfig
```kconfig
if SHIELD_NICE_ERGODOX_LEFT

config ZMK_KEYBOARD_NAME
	default "Nice ErgoDox"
	
config ZMK_SPLIT_BLE_ROLE_CENTRAL
	default y

endif

if SHIELD_NICE_ERGODOX_LEFT || SHIELD_NICE_ERGODOX_RIGHT

config ZMK_SPLIT
	default y
endif
```

## config/boards/shields/nice_ergodox/Kconfig.shield
```kconfig
config SHIELD_NICE_ERGODOX_LEFT
	def_bool $(shields_list_contains,nice_ergodox_left)

config SHIELD_NICE_ERGODOX_RIGHT
	def_bool $(shields_list_contains,nice_ergodox_right)
```

## config/boards/shields/split_atreus/Kconfig.defconfig
```kconfig
if SHIELD_SPLIT_ATREUS_RIGHT

config ZMK_KEYBOARD_NAME
	default "split atreus"
	
config ZMK_SPLIT_BLE_ROLE_CENTRAL
	default y
endif

if SHIELD_SPLIT_ATREUS_LEFT || SHIELD_SPLIT_ATREUS_RIGHT

config ZMK_SPLIT
	default y
endif
```

## config/boards/shields/split_atreus/Kconfig.shield
```kconfig
config SHIELD_SPLIT_ATREUS_LEFT
	def_bool $(shields_list_contains,split_atreus_left)

config SHIELD_SPLIT_ATREUS_RIGHT
	def_bool $(shields_list_contains,split_atreus_right)
```
